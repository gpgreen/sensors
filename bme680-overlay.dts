/dts-v1/;
/plugin/;


/ {
	compatible = "brcm,bcm2708", "brcm,bcm2709", "brcm,bcm2711", "brcm,bcm2835";

        /* the environmental sensor */
        fragment@0 {
            target = <&i2c1>;
            __overlay__ {
            	/* needed to avoid dtc warning */
		/* #address-cells = <1>; */
		/* #size-cells = <0>; */
		bme680@0 {
                    compatible = "bosch,bme680";
                    reg = <0x77>;
                };
            };
        };
};
